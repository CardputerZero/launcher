## ext_components/RadioLib/Kconfig
```kconfig
menuconfig RADIOLIB_COMPONENT_ENABLED
    bool "Enable RadioLib"
    default n
    help
        Enable the RadioLib external component and expose RadioLib headers and
        the SX126x/SX1262 implementation used by LoRa applications.
```

## ext_components/cp0_lvgl/Kconfig
```kconfig
menuconfig CP0_LVGL_COMPONENT_ENABLED
    bool "Enable cp0 lvgl support"
    default n

if CP0_LVGL_COMPONENT_ENABLED

config CP0_LVGL_USE_ZMQ_LOG
    bool "Enable cp0 lvgl zmq log publisher"
    default n

config CP0_LVGL_USE_ZMQ_RPC
    bool "Enable cp0 lvgl local ZMQ automation RPC"
    default n

endif
```

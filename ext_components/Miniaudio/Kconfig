## ext_components/Miniaudio/Kconfig
```kconfig
# SPDX-FileCopyrightText: 2026 M5Stack Technology CO LTD
# SPDX-License-Identifier: MIT


menuconfig MINIAUDIO_COMPONENT_ENABLED
    bool "Enable Miniaudio"
    default n
```

## ext_components/Sigslot/Kconfig
```kconfig
# SPDX-FileCopyrightText: 2026 M5Stack Technology CO LTD
# SPDX-License-Identifier: MIT


menuconfig SIGSLOT_COMPONENT_ENABLED
    bool "Enable Sigslot"
    default n
```

## ext_components/SmoothUI/Kconfig
```kconfig
# SPDX-FileCopyrightText: 2026 M5Stack Technology CO LTD
# SPDX-License-Identifier: MIT

menuconfig SMOOTH_UI_COMPONENT_ENABLED
    bool "Smooth UI Toolkit"
    default n
    help
        Enable the Smooth UI Toolkit component.
```

## ext_components/Spdlog/Kconfig
```kconfig
# SPDX-FileCopyrightText: 2026 M5Stack Technology CO LTD
# SPDX-License-Identifier: MIT

menuconfig SPDLOG_COMPONENT_ENABLED
    bool "Enable spdlog"
    default n
    help
        Enable the spdlog logging library component.
```

## projects/HelloWorld/main/Kconfig
```kconfig
# SPDX-FileCopyrightText: 2026 M5Stack Technology CO LTD
# SPDX-License-Identifier: MIT

config COMPILE_FOR_WEB
    bool 'commpile web msg!'
    default n
config COMPILE_FOR_WIN32
    bool 'commpile win32 msg!'
    default n
config COMPILE_FOR_LINUX
    bool 'commpile linux msg!'
    default n
```
